#include <behaviors.dtsi>
#include <dt-bindings/zmk/keys.h>
/ {
    keymap {
        compatible = "zmk,keymap";

        default_layer { // Layer 0
            bindings = <
                &kp N1   &kp N2   &kp N3   &kp N4   &kp N5   &kp A   &kp B   &kp C   &kp D   &kp E   &kp F   &kp N6   &kp N7   &kp N8   &kp N9   &kp N0
            >;
        };
    };
 };