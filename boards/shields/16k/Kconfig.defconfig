## boards/shields/16k/Kconfig.defconfig
```kconfig
if SHIELD_16K_C

# Name must be less than 16 characters long!
config ZMK_KEYBOARD_NAME
    default "16k"

config ZMK_SPLIT_ROLE_CENTRAL
    default y

endif

if SHIELD_16K_L || SHIELD_16K_R

config ZMK_SPLIT
    default y

endif
```

## config/boards/shields/16k/Kconfig.defconfig
```kconfig
# Copyright (c) 2020 The ZMK Contributors
# SPDX-License-Identifier: MIT

if SHIELD_16K_C

config ZMK_KEYBOARD_NAME
	default "16k"
	
config ZMK_SPLIT_BLE_ROLE_CENTRAL
	default y
	
config ZMK_USB
	default y

endif

if SHIELD_16K_C || SHIELD_16K_L || SHIELD_16K_R

config ZMK_SPLIT
	default y

config ZMK_BLE
	default y
	
endif
```

## config/boards/shields/16k/Kconfig.shield
```kconfig
# No whitespace after the comma or in your part name!
config SHIELD_16K_C
    def_bool $(shields_list_contains,16k_c)

# No whitespace after the comma or in your part name!
config SHIELD_16K_L
    def_bool $(shields_list_contains,16k_l)

# No whitespace after the comma or in your part name!
config SHIELD_16K_R
    def_bool $(shields_list_contains,16k_r)
```

## config/boards/shields/k/Kconfig.shield
```kconfig
# No whitespace after the comma or in your part name!
config SHIELD_K_C
    def_bool $(shields_list_contains,k_c)

# No whitespace after the comma or in your part name!
config SHIELD_K_L
    def_bool $(shields_list_contains,k_l)

# No whitespace after the comma or in your part name!
config SHIELD_K_R
    def_bool $(shields_list_contains,k_r)
```
