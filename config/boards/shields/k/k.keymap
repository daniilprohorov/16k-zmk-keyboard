#include <behaviors.dtsi>
#include <dt-bindings/zmk/keys.h>
/ {
    keymap {
        compatible = "zmk,keymap";

        default_layer { // Layer 0
            bindings = <
                &kp 1    &kp 2
            >;
        };
    };
 };